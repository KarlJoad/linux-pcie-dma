## fpga-char-test/Config.in
```kconfig
config BR2_PACKAGE_FPGA_CHAR_TEST
       bool "virtine-test"
       default y
       depends on BR2_PACKAGE_FPGA_CHAR
```

## fpga-char/Config.in
```kconfig
config BR2_PACKAGE_FPGA_CHAR
        bool "fpga-char"
        default y
        depends on BR2_LINUX_KERNEL
        help
                Linux Kernel Module Cheat.
```

## hello-world/Config.in
```kconfig
config BR2_PACKAGE_HELLO_WORLD
        bool "hello-world"
        default y
        depends on BR2_LINUX_KERNEL
        help
                Linux Kernel Module Cheat.
```
